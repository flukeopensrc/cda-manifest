## conf/local.conf
```bitbake
# CONF_VERSION is increased each time build/conf/ changes incompatibly
CONF_VERSION = "1"

#INHERIT += "rm_work"

# Which files do we want to parse:
BBMASK = ""

# What kind of images do we want?
IMAGE_FSTYPES_append = " tar.xz"

DISTRO ?= "angstrom"
# Set DEPLOY_DIR outside of TMPDIR

DEPLOY_DIR = "${TMPDIR}/../deploy/${TCLIBC}"
# Don't generate the mirror tarball for SCM repos, the snapshot is enough
BB_GENERATE_MIRROR_TARBALLS = "0"

#create license packages and add them to runtime recommendations
LICENSE_CREATE_PACKAGE = "1"

# Disable build time patch resolution. This would lauch a devshell
# and wait for manual intervention. We disable it.
PATCHRESOLVE = "noop"

#
# Parallelism Options
#
# These two options control how much parallelism BitBake should use. The first
# option determines how many tasks bitbake should run in parallel:
# Default to setting automatically based on cpu count
#BB_NUMBER_THREADS ?= "${@oe.utils.cpu_count()}"
BB_NUMBER_THREADS ?= "3"
#
# The second option controls how many processes make should run in parallel when
# running compile tasks:
# Default to setting automatically based on cpu count
#PARALLEL_MAKE ?= "-j ${@oe.utils.cpu_count()}"
PARALLEL_MAKE ?= "-j 6"

#
# Shared-state files from other locations
#
# Shared state files are prebuilt cache data objects which can
# used to accelerate build time. This variable can be used to configure the system
# to search other mirror locations for these objects before it builds the data itself.
#
# This can be a filesystem directory, or a remote url such as http or ftp. These
# would contain the sstate-cache results from previous builds (possibly from other
# machines). This variable works like fetcher MIRRORS/PREMIRRORS and points to the
# cache locations to check for the shared objects.
#SSTATE_MIRRORS ?= "\
#file://.* http://someserver.tld/share/sstate/ \n \
#file://.* file:///some/local/dir/sstate/"

#SSTATE_MIRRORS ?= "\
#file://.* http://dominion.thruhere.net/angstrom/sstate-mirror/ \n "

# enable PR service on build machine itself
# its good for a case when this is the only builder
# generating the feeds
#
PRSERV_HOST = "localhost:0"

OE_TERMINAL = "auto"

PACKAGECONFIG_DISTRO_append = " linuxfb"

# disable stuff we don't need, mostly to make meta-toolchain-qt5 smaller and
# faster to build
DISTRO_FEATURES_remove = " x11 3g pulseaudio opengl wayland"

# add fbdev so we can build x11vnc without x11
DISTRO_FEATURES_append = " fbdev"

# gcc 10 made "-fno-common" the default, which breaks compilation of various packages
# in Zeus.  So we make sure to use -fcommon until we upgrade to a newer yocto release.
# gcc 10 made "-fno-common" the default, which breaks compilation of various packages
# in Zeus.  So we make sure to use -fcommon until we upgrade to a newer yocto release.
TARGET_CFLAGS += "-fcommon"
TARGET_CXXFLAGS += "-fcommon"
BUILD_CFLAGS += "-fcommon"
BUILD_CXXFLAGS += "-fcommon"
BUILDSDK_CFLAGS += "-fcommon"
BUILDSDK_CXXFLAGS += "-fcommon"
```
